## device/i9300/drivers/mmc/host/Kconfig
```kconfig
config MMC_MSHCI
        tristate "Mobile Storage Host Controller Interface support"
	depends on HAS_DMA
	help
	  This selects the Mobile Storage Host Controller Interface.
	  It is made by synopsys. It supports SD/MMC card.

	  If you have a controller with this interface, say Y or M here. You
          also need to enable an appropriate bus interface.

          If unsure, say N.

config MMC_MSHCI_S3C_DMA_MAP
	tristate "Use own S3C_DMA_MAP function for mshci"
	depends on MMC_MSHCI
	help
	  This selects using the s3c_dma_map_sg, s3c_unmap_sg functions.
	  Those functions are optimized for flushing cache.

	  If unsure, say N.

config MMC_MSHCI_ASYNC_OPS
	tristate "Use Asyn ops like pre_req, post_req"
	depends on MMC_MSHCI
	help
	  This selects using the pre_req and post_req functions.
	  These functions might make the performance of MMC better.

	  If unsure, say N.

config MMC_MSHCI_ENABLE_CACHE
	tristate "Use Cache defined in eMMC 4.5"
	depends on MMC_MSHCI
	default n
	help
	  This selects eMMC cache control feature of eMMC4.5.
	  These functions might make the performance of MMC better.
	  This should be used when the eMMC device  supports cache feature.

	  If unsure, say N.

config MMC_SDHCI_S3C_LEGACY
	tristate "SDHCI support on Samsung S3C SoC"
	depends on MMC_SDHCI && PLAT_SAMSUNG_LEGACY
	help
	  This selects the Secure Digital Host Controller Interface (SDHCI)
	  often referrered to as the HSMMC block in some of the Samsung S3C
	  range of SoC.

	  Note, due to the problems with DMA, the DMA support is only
	  available with CONFIG_EXPERIMENTAL is selected.

	  If you have a controller with this interface, say Y or M here.

	  If unsure, say N.

config MMC_SDHCI_S3C_LEGACY_DMA
	bool "DMA support on S3C SDHCI"
	depends on MMC_SDHCI_S3C_LEGACY && EXPERIMENTAL
	help
	  Enable DMA support on the Samsung S3C SDHCI glue. The DMA
	  has proved to be problematic if the controller encounters
	  certain errors, and thus should be treated with care.

	  YMMV.
```
