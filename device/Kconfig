## device/i9300/Kconfig
```kconfig
source "device/i9300/arch/Kconfig"
source "device/i9300/init/Kconfig"
source "device/i9300/kernel/Kconfig"
source "device/i9300/drivers/Kconfig"
source "device/i9300/net/Kconfig"
```

## device/i9300/arch/arm/Kconfig
```kconfig
source "device/i9300/arch/arm/common/Kconfig"

config ARM_TRUSTZONE
	bool "Support TrustZone-enabled Trusted Execution Environment"
	default n
	help
	  Select if you want a kernel to be executed at non-secure world.
	  This option should be used with related secure bootloader and
	  TrustZone software.

	  If you don't know about TrustZone, say 'N'.
```

## device/i9300/arch/arm/mm/Kconfig
```kconfig
config IDIV_EMULATE
	bool "Emulate SDIV/UDIV instructions"
	depends on !CPU_USE_DOMAINS && CPU_V7
	select HAVE_PROC_CPU if PROC_FS
	default y if SMP
	help

	  The Virtualization Extensions introduce the requirement for an
	  ARMv7-A implementation to include SDIV and UDIV.  Any
	  implementation of the Virtualization Extensions must include
	  the SDIV and UDIV instructions in the Thumb and ARM
	  instruction sets.

	  In an ARMv7-A implementation that does not include the
	  Virtualization Extensions, it is IMPLEMENTATION DEFINED whether:
	  *  SDIV and UDIV are not implemented
	  *  SDIV and UDIV are implemented only in the Thumb instruction set
	  *  SDIV and UDIV are implemented in the Thumb and ARM
	  instruction sets.

	  This option allows to handle exeptions due to unimplemented
	  SDIV and UDIV instructions in ARM and Thumb modes.

	  If unsure, say Y.
```

## device/i9300/drivers/Kconfig
```kconfig
source "device/i9300/drivers/base/Kconfig"
source "device/i9300/drivers/battery/Kconfig"

# Secure OS Mobicore
source "device/i9300/drivers/gud/Kconfig"

source "device/i9300/drivers/gpu/Kconfig"
source "device/i9300/drivers/input/Kconfig"
source "device/i9300/drivers/leds/Kconfig"
source "device/i9300/drivers/media/Kconfig"
source "device/i9300/drivers/mfd/Kconfig"
source "device/i9300/drivers/misc/Kconfig"
source "device/i9300/drivers/motor/Kconfig"
source "device/i9300/drivers/mmc/Kconfig"
source "device/i9300/drivers/net/Kconfig"
source "device/i9300/drivers/power/Kconfig"
source "device/i9300/drivers/regulator/Kconfig"
source "device/i9300/drivers/rtc/Kconfig"
source "device/i9300/drivers/samsung/Kconfig"
source "device/i9300/drivers/sensor/Kconfig"
source "device/i9300/drivers/switch/Kconfig"
source "device/i9300/drivers/thermal/Kconfig"
source "device/i9300/drivers/usb/Kconfig"
source "device/i9300/drivers/video/Kconfig"
```

## device/i9300/drivers/base/Kconfig
```kconfig
config SYNC
	bool "Synchronization framework"
	default n
	select ANON_INODES
	help
	  This option enables the framework for synchronization between multiple
	  drivers.  Sync implementations can take advantage of hardware
	  synchronization built into devices like GPUs.

config SW_SYNC
	bool "Software synchronization objects"
	default n
	depends on SYNC
	help
	  A sync object driver that uses a 32bit counter to coordinate
	  syncrhronization.  Useful when there is no hardware primitive backing
	  the synchronization.

config SW_SYNC_USER
       bool "Userspace API for SW_SYNC"
       default n
       depends on SW_SYNC
       help
         Provides a user space API to the sw sync object.
         *WARNING* improper use of this can result in deadlocking kernel
	 drivers from userspace.


config DMA_SHARED_BUFFER
	bool "Buffer framework to be shared between drivers"
	default n
	depends on ANON_INODES
	help
	  This option enables the framework for buffer-sharing between
	  multiple drivers. A buffer is associated with a file using driver
	  APIs extension; the file's descriptor can then be passed on to other
	  driver.

config DMA_CMA
	bool "Contiguous Memory Allocator (EXPERIMENTAL)"
	default n
	select MIGRATION
	help
	  This enables the Contiguous Memory Allocator which allows drivers
	  to allocate big physically-contiguous blocks of memory for use with
	  hardware components that do not support I/O map nor scatter-gather.

	  For more information see <include/linux/dma-contiguous.h>.
	  If unsure, say "n".

if DMA_CMA

config DMA_CMA_DEBUG
	bool "NEW CMA debug messages (DEVELOPMENT)"
	depends on DEBUG_KERNEL
	help
	  Turns on debug messages in CMA.  This produces KERN_DEBUG
	  messages for every CMA call as well as various messages while
	  processing calls such as dma_alloc_from_contiguous().
	  This option does not affect warning and error messages.

comment "Default contiguous memory area size:"

config CMA_SIZE_MBYTES
	int "Size in Mega Bytes"
	depends on !CMA_SIZE_SEL_PERCENTAGE
	default 16
	help
	  Defines the size (in MiB) of the default memory area for CMA.

config CMA_SIZE_PERCENTAGE
	int "Percentage of total memory"
	depends on !CMA_SIZE_SEL_MBYTES
	default 10
	help
	  Defines the size of the default memory area for Contiguous Memory
	  Allocator as a percentage of the total memory in the system.

choice
	prompt "Selected region size"
	default CMA_SIZE_SEL_ABSOLUTE

config CMA_SIZE_SEL_MBYTES
	bool "Use mega bytes value only"

config CMA_SIZE_SEL_PERCENTAGE
	bool "Use percentage value only"

config CMA_SIZE_SEL_MIN
	bool "Use lower value (minimum)"

config CMA_SIZE_SEL_MAX
	bool "Use higher value (maximum)"

endchoice

config CMA_ALIGNMENT
	int "Maximum PAGE_SIZE order of alignment for contiguous buffers"
	range 4 9
	default 8
	help
	  DMA mapping framework by default aligns all buffers to the smallest
	  PAGE_SIZE order which is greater than or equal to the requested buffer
	  size. This works well for buffers up to a few hundreds kilobytes, but
	  for larger buffers it just a memory waste. With this parameter you can
	  specify the maximum PAGE_SIZE order for contiguous buffers. Larger
	  buffers will be aligned only to this specified order. The order is
	  expressed as a power of two multiplied by the PAGE_SIZE.

	  For example, if your system defaults to 4KiB pages, the order value
	  of 8 means that the buffers will be aligned up to 1MiB only.

	  If unsure, leave the default value "8".

config CMA_AREAS
	int "Maximum count of the CMA device-private areas"
	default 7
	help
	  CMA allows to create CMA areas for particular devices. This parameter
	  sets the maximum number of such device private CMA areas in the
	  system.

	  If unsure, leave the default value "7".

endif
```

## device/i9300/drivers/char/Kconfig
```kconfig
config DEVMEM
	bool "Memory device driver"
	default y
	help
	  The memory driver provides two character devices, mem and kmem, which
	  provide access to the system's memory. The mem device is a view of
	  physical memory, and each byte in the device corresponds to the
	  matching physical address. The kmem device is the same as mem, but
	  the addresses correspond to the kernel's virtual address space rather
	  than physical memory. These devices are standard parts of a Linux
	  system and most users should say Y here. You might say N if very
	  security conscience or memory is tight.

config S3C_MEM
	bool "Support for /dev/s3c-mem"
	default n
	---help---
	  If you do say Y here, you can allocate physically linear memories from system memory.
	  And you can share the memory at the other process using re-allocation ioctl.

	  If unsure, say Y.

config EXYNOS_MEM
	bool "Support for /dev/exynos-mem"
	depends on CMA
	default n
	help
	  If you do say Y here, you can mmap using physically linear memories.
	  And you can flush it using ioctl.
```

## device/i9300/drivers/gpio/Kconfig
```kconfig
config GPIO_PLAT_SAMSUNG
	def_bool y
	depends on SAMSUNG_GPIOLIB_4BIT

config GPIO_EXYNOS4
	def_bool y
	depends on ARCH_EXYNOS4
```

## device/i9300/drivers/gpu/Kconfig
```kconfig
source "device/i9300/drivers/gpu/ion/Kconfig"
source "device/i9300/drivers/gpu/mali400/Kconfig"
```

## device/i9300/drivers/gpu/ion/Kconfig
```kconfig
config ION_EXYNOS
        tristate "Ion for Exynos"
        depends on ARCH_EXYNOS && ION
        select CMA
        help
          Choose this option if you wish to use ion on a Samsung Exynos.

config ION_EXYNOS_CONTIGHEAP_SIZE
        int "Size in Kilobytes of memory pool of EXYNOS_CONTIG_HEAP"
        depends on ION_EXYNOS && CMA
        default 45056

config ION_EXYNOS_CONTIGHEAP_DEBUG
        bool "Debug message for allocation, free of CONTIGHEAP"
        depends on ION_EXYNOS && CMA
        default n
```

## device/i9300/drivers/input/Kconfig
```kconfig
source "device/i9300/drivers/input/keyboard/Kconfig"
source "device/i9300/drivers/input/touchscreen/Kconfig"
```

## device/i9300/drivers/input/misc/Kconfig
```kconfig
config INPUT_KEYCHORD
	tristate "Key chord input driver support"
	help
	  Say Y here if you want to enable the key chord driver
	  accessible at /dev/keychord.  This driver can be used
	  for receiving notifications when client specified key
	  combinations are pressed.

	  To compile this driver as a module, choose M here: the
	  module will be called keychord.

config INPUT_GPIO
	tristate "GPIO driver support"
	help
	  Say Y here if you want to support gpio based keys, wheels etc...
```

## device/i9300/drivers/input/touchscreen/Kconfig
```kconfig
config TOUCHSCREEN_MELFAS
	tristate "MELFAS touchscreen driver"
	depends on I2C
	help
	  Say Y here if you have a MELFAS touchscreen.

	  If unsure, say N.
```

## device/i9300/drivers/leds/Kconfig
```kconfig
config LEDS_AAT1290A
	bool "LED support for the AAT1290A"
	depends on LEDS_CLASS
	default n
	help
	  This option enables support for the LEDs on the AAT1290A.

config LEDS_AN30259A
	tristate "LED driver for panasonic AN30259A RGB LED"
	depends on I2C
	help
	  This option enables support for AN30259A RGB LED chips
	  accessed via the I2C bus.
	  AN30259A has three channel LED driver. By synchronous clock
	  function, combined operation is possible.
```

## device/i9300/drivers/media/video/Kconfig
```kconfig
choice
prompt "Select Videobuf2 allocator"
default VIDEOBUF2_CMA_PHYS
config VIDEOBUF2_CMA_PHYS
       bool "CMA_PHYS"
       depends on CMA
       select VIDEOBUF2_CORE
       select VIDEOBUF2_MEMOPS
       help
         Use videobuf2 CMA-phys allocator

config VIDEOBUF2_ION
       bool "Android ION"
       depends on ION_EXYNOS
       select VIDEOBUF2_CORE
       select VIDEOBUF2_MEMOPS
       help
         Use videobuf2 Android ION allocator
endchoice

config VIDEO_S5K6A3
       tristate "S5K6A3 supporting camera driver"
       depends on VIDEO_V4L2 && ((VIDEO_FIMC_MIPI || VIDEO_S5P_MIPI_CSIS) && VIDEO_EXYNOS_FIMC_IS) || VIDEO_EXYNOS5_FIMC_IS
       ---help---
         This driver supports S5K6A3 sensor.

choice
depends on VIDEO_S5K6A3
prompt "MIPI Camera port for S5K6A3"
default S5K6A3_CSI_D
config S5K6A3_CSI_C
       bool "CSI Camera A port"
       depends on (VIDEO_FIMC_MIPI || VIDEO_S5P_MIPI_CSIS || VIDEO_EXYNOS5_FIMC_IS)
       help
         This enables support for CSI A port
config S5K6A3_CSI_D
       bool "CSI Camera B port"
       depends on (VIDEO_FIMC_MIPI || VIDEO_S5P_MIPI_CSIS || VIDEO_EXYNOS5_FIMC_IS)
       help
         This enalbes support for CSI B port
endchoice

config VIDEO_S5C73M3
       tristate "S5C73M3 MIPI CSI-2 supporting camera driver"
       depends on I2C && VIDEO_V4L2 && VIDEO_FIMC_MIPI
       ---help---
         This driver supports s5c73m3 ISP camera module with
         MIPI CSI-2 as well

config VIDEO_S5C73M3_SPI
       tristate "S5C73M3 SPI driver"
       depends on SPI && (VIDEO_S5C73M3 || VIDEO_SLP_S5C73M3)
       ---help---
         This driver supports s5c73m3 SPI

config SAMSUNG_MFC_DRIVERS
       bool "Samsung EXYNOS MFC driver"
       ---help---
         This is a v4l2 driver for Samsung EXYNOS4/EXYNOS5 MFC.

if SAMSUNG_MFC_DRIVERS

choice
       prompt "Select MFC driver type"
       default USE_LEGACY_MFC
config USE_LEGACY_MFC
       bool "Legacy style MFC"
       depends on VIDEO_SAMSUNG && ARCH_EXYNOS4
       select VIDEO_MFC5X
       ---help---
         Use MFC legacy style driver.

config USE_V4L2_MFC
       bool "V4L2 style MFC"
       depends on VIDEO_V4L2 && PLAT_S5P
       select VIDEO_SAMSUNG_S5P_MFC
       select VIDEO_FIXED_MINOR_RANGES
       ---help---
         Use MFC V4L2 style driver.

endchoice

config VIDEO_SAMSUNG_S5P_MFC
       bool
       depends on USE_V4L2_MFC
       select VIDEOBUF2_CORE
       ---help---
         MFC driver for V4L2.

choice
       prompt "MFC V4L2 Driver"
       default S5P_MFC_V5
       depends on USE_V4L2_MFC
       ---help---
         Select version of MFC driver

config S5P_MFC_V5
       bool "MFC 5.x"
       ---help---
         Use MFC 5.x V4L2 Driver

config S5P_MFC_V6
       bool "MFC 6.x"
       ---help---
         Use MFC 6.x V4L2 Driver
endchoice
endif

source "device/i9300/drivers/media/video/samsung/Kconfig"
source "device/i9300/drivers/media/video/exynos/Kconfig"

source "device/i9300/drivers/media/video/mhl/Kconfig"
```

## device/i9300/drivers/mfd/Kconfig
```kconfig
config MFD_MAX77686_LEGACY
	bool "Maxim Semiconductor MAX77686 PMIC Support"
	depends on I2C=y && GENERIC_HARDIRQS
	select MFD_CORE
	help
	  Say yes here to support for Maxim Semiconductor MAX77686.
	  This is a Power Management IC with RTC on chip.
	  This driver provides common support for accessing the device;
	  additional drivers must be enabled in order to use the functionality
	  of the device.

config MFD_MAX77693_LEGACY
	bool "Maxim Semiconductor MAX77693 PMIC Support"
	depends on I2C=y && GENERIC_HARDIRQS
	select MFD_CORE
	help
	  Say yes here to support for Maxim Semiconductor MAX77963.
	  This is a Power Management IC with RTC, Flash, Fuel Gauge, Haptic,
	  MUIC controls on chip.
	  This driver provides common support for accessing the device;
	  additional drivers

config MFD_WM8994_LEGACY
	bool "Support Wolfson Microelectronics WM8994"
	select MFD_CORE
	select REGMAP_I2C
	select REGMAP_IRQ
	depends on I2C=y && GENERIC_HARDIRQS
	help
	  The WM8994 is a highly integrated hi-fi CODEC designed for
	  smartphone applicatiosn.  As well as audio functionality it
	  has on board GPIO and regulator functionality which is
	  supported via the relevant subsystems.  This driver provides
	  core support for the WM8994, in order to use the actual
	  functionaltiy of the device other drivers must be enabled.
```

## device/i9300/drivers/misc/Kconfig
```kconfig
config MUIC_MAX77693_SEPARATE_MHL_PORT
	bool "MUIC_MAX77693_SEPARATE_MHL_PORT"
	depends on MFD_MAX77693
	default n
	help
	  If you say yes here you will get support for the separated
	  MHL port.

config MUIC_MAX77693_SUPPORT_OTG_AUDIO_DOCK
	bool "MUIC_MAX77693_SUPPORT_OTG_AUDIO_DOCK"
	depends on MFD_MAX77693
	default n
	help
	  If you say yes here you will get support for the OTG audio dock.

config MUIC_MAX77693_SUPPORT_SMART_DOCK
	bool "MUIC_MAX77693_SUPPORT_SMART_DOCK"
	depends on MFD_MAX77693
	default n
	help
	  If you say yes here you will get support for the smart dock.

config MUIC_MAX77693_SUPPORT_CAR_DOCK
	bool "MUIC_MAX77693_SUPPORT_CAR_DOCK"
	depends on MFD_MAX77693
	default n
	help
	  If you say yes here you will get support for the car dock.

source "device/i9300/drivers/misc/modem_if/Kconfig"
```

## device/i9300/drivers/mmc/Kconfig
```kconfig
source "device/i9300/drivers/mmc/card/Kconfig"
source "device/i9300/drivers/mmc/core/Kconfig"
source "device/i9300/drivers/mmc/host/Kconfig"
```

## device/i9300/drivers/mmc/card/Kconfig
```kconfig
config MMC_SELECTIVE_PACKED_CMD_POLICY
	tristate "Change the condition of Pakced command"
	help
	  Say Y here to change packed_cmd policy
```
