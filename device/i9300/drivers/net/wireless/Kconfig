## device/i9300/kernel/power/Kconfig
```kconfig
config PM_WATCHDOG_TIMEOUT
	bool "PM Watchdog timeout"
	depends on CPU_EXYNOS4210
	default y
	---help---
	  Enable PM watchdog timer to catch lockup during early_suspend,
	  late_resume and suspend_finish.

config FULL_PAGE_RECLAIM
	bool "Using Full Page Reclaim during Suspend-to-Disk"
	depends on HIBERNATION
	default n
	---help---
	  Reclaim whole pages if possible before creating hibernation snapshot
	  image. For reducing snapshot image size, reclaim them.

	  With this config, the size of hibernation snapshot image is
	  dramatically decreased and small size of hibernation snapshot image
	  has benefit for fast booting.

config FAST_BOOT
	bool "Force suspend and show fake turn off which is same with suspend"
	depends on SUSPEND
	default n
	---help---
	  This allows you go to suspend instead to turn off. If this is
	  done, it goes to wake up instead to turn on. This works with power
	  source.

config HAS_WAKELOCK
	bool

config HAS_EARLYSUSPEND
	bool

config WAKELOCK
	bool "Wake lock"
	depends on PM && RTC_CLASS
	default n
	select HAS_WAKELOCK
	---help---
	  Enable wakelocks. When user space request a sleep state the
	  sleep request will be delayed until no wake locks are held.

config WAKELOCK_STAT
	bool "Wake lock stats"
	depends on WAKELOCK
	default y
	---help---
	  Report wake lock stats in /proc/wakelocks

config USER_WAKELOCK
	bool "Userspace wake locks"
	depends on WAKELOCK
	default y
	---help---
	  User-space wake lock api. Write "lockname" or "lockname timeout"
	  to /sys/power/wake_lock lock and if needed create a wake lock.
	  Write "lockname" to /sys/power/wake_unlock to unlock a user wake
	  lock.

config EARLYSUSPEND
	bool "Early suspend"
	depends on WAKELOCK
	default y
	select HAS_EARLYSUSPEND
	---help---
	  Call early suspend handlers when the user requested sleep state
	  changes.

choice
	prompt "User-space screen access"
	default FB_EARLYSUSPEND if !FRAMEBUFFER_CONSOLE
	default CONSOLE_EARLYSUSPEND
	depends on HAS_EARLYSUSPEND

	config NO_USER_SPACE_SCREEN_ACCESS_CONTROL
		bool "None"

	config CONSOLE_EARLYSUSPEND
		bool "Console switch on early-suspend"
		depends on HAS_EARLYSUSPEND && VT
		---help---
		  Register early suspend handler to perform a console switch to
		  when user-space should stop drawing to the screen and a switch
		  back when it should resume.

	config FB_EARLYSUSPEND
		bool "Sysfs interface"
		depends on HAS_EARLYSUSPEND
		---help---
		  Register early suspend handler that notifies and waits for
		  user-space through sysfs when user-space should stop drawing
		  to the screen and notifies user-space when it should resume.
endchoice

config FAST_RESUME
	bool "Using fast resume during Suspend-to-Disk"
	depends on HIBERNATION
	---help---
	  software_resume() function which triggers hibernation restore is
	  called faster on booting time by introducing new initcalls. This has
	  benefit for fast booting on hibernation

config SUSPEND_TIME
	bool "Log time spent in suspend"
	---help---
	  Prints the time spent in suspend in the kernel log, and
	  keeps statistics on the time spent in suspend in
	  /sys/kernel/debug/suspend_time

config CPU_PM
	bool
	depends on SUSPEND || CPU_IDLE

config PM_WAKELOCKS
	bool "User space wakeup sources interface"
	depends on PM_SLEEP
	default n
	---help---
	Allow user space to create, activate and deactivate wakeup source
	objects with the help of a sysfs-based interface.
```

## device/i9300/net/Kconfig
```kconfig
config ANDROID_PARANOID_NETWORK
	bool "Only allow certain groups to create sockets"
	default y
	help
	  none

config NET_ACTIVITY_STATS
	bool "Network activity statistics tracking"
	default y
	help
	 Network activity statistics are useful for tracking wireless
	 modem activity on 2G, 3G, 4G wireless networks. Counts number of
	 transmissions and groups them in specified time buckets.
```

## device/i9300/sound/soc/samsung/Kconfig
```kconfig
config SND_SOC_SAMSUNG_MIDAS_WM1811
	tristate "SoC I2S Audio support for WM1811 on MIDAS"
	depends on SND_SOC_SAMSUNG && MACH_MIDAS
	select SND_SOC_WM8994
	select SND_SAMSUNG_I2S
	help
	  Say Y if you want to add support for SoC audio on the MIDAS.

config SND_SOC_SAMSUNG_I2S_SEC
	bool "I2S operate secondary FIFO"
        depends on SND_SAMSUNG_LP || SND_SAMSUNG_ALP

choice
	prompt "Samsung I2S Audio type"
	depends on SND_SAMSUNG_I2S && (ARCH_EXYNOS4 || ARCH_S5PV210 || ARCH_EXYNOS5)
	default SND_SAMSUNG_NORMAL

config SND_SAMSUNG_NORMAL
	bool "Normal Audio support"
	help
	  Say Y if you want to support normal audio.

config SND_SAMSUNG_LP
	bool "LP Audio support"
	select SND_SOC_SAMSUNG_I2S_SEC
	help
	  Say Y if you want to support LP audio.

# For support SRP audio
source "device/i9300/sound/soc/samsung/srp_alp/Kconfig"
source "device/i9300/sound/soc/samsung/srp_ulp/Kconfig"

endchoice

config AUDIO_SAMSUNG_MEMSIZE_SRP
	int "Memory size in kbytes for Low power Audio"
	depends on SND_SAMSUNG_RP || SND_SAMSUNG_ALP
	default "1024"

config SND_SAMSUNG_RP_DEBUG
	bool "Enable debug message for ULP & ALP Audio"
	depends on SND_SAMSUNG_RP || SND_SAMSUNG_ALP
	default n
	help
	  Say Y if you want to add debug message for ULP & ALP Audio.

config SND_DUOS_MODEM_SWITCH
	bool "Select DUOS Modem"
	depends on SND_SOC_SAMSUNG

config SND_USE_SUB_MIC
	bool "Use SUB_MIC"
	depends on SND_SOC_SAMSUNG

config SND_USE_THIRD_MIC
	bool "Use THIRD_MIC"
	depends on SND_SOC_SAMSUNG

config SND_USE_STEREO_SPEAKER
	bool "Use STEREO_SPEAKER"
	depends on SND_SOC_SAMSUNG
	help
	  Support stereo speaker for Samsung's Tablet-PC device.

config SND_USE_LINEOUT_SWITCH
	bool "Use LINEOUT_SWITCH"
	depends on SND_SOC_SAMSUNG

config SND_USE_MUIC_SWITCH
	bool "Use MUIC_SWITCH CONTROL"
	depends on SND_SOC_SAMSUNG
```

## drivers/mmc/core/Kconfig
```kconfig
#
# MMC core configuration
#

config MMC_UNSAFE_RESUME
	bool "Assume MMC/SD cards are non-removable (DANGEROUS)"
	help
	  If you say Y here, the MMC layer will assume that all cards
	  stayed in their respective slots during the suspend. The
	  normal behaviour is to remove them at suspend and
	  redetecting them at resume. Breaking this assumption will
	  in most cases result in data corruption.

	  This option is usually just for embedded systems which use
	  a MMC/SD card for rootfs. Most people should say N here.

	  This option sets a default which can be overridden by the
	  module parameter "removable=0" or "removable=1".

config MMC_CLKGATE
	bool "MMC host clock gating (EXPERIMENTAL)"
	depends on EXPERIMENTAL
	help
	  This will attempt to aggressively gate the clock to the MMC card.
	  This is done to save power due to gating off the logic and bus
	  noise when the MMC card is not in use. Your host driver has to
	  support handling this in order for it to be of any use.

	  If unsure, say N.

config MMC_POLLING_WAIT_CMD23
	bool "Wait for cmd23's done interrupt by polling check (EXPERIMENTAL)"
	depends on EXPERIMENTAL
	help
	  If you say Y here, cmd23 dose not use interrupt.
```

## midas/mfd/Kconfig
```kconfig
config MIDAS_MFD_MAX77686
	bool "Maxim Semiconductor MAX77686 PMIC Support"
	depends on I2C=y && GENERIC_HARDIRQS
	select MFD_CORE
	help
	  Say yes here to support for Maxim Semiconductor MAX77686.
	  This is a Power Management IC with RTC on chip.
	  This driver provides common support for accessing the device;
	  additional drivers must be enabled in order to use the functionality
	  of the device.

config MIDAS_MFD_MAX77693
	bool "Maxim Semiconductor MAX77693 PMIC Support"
	depends on I2C=y && GENERIC_HARDIRQS
	select MFD_CORE
	help
	  Say yes here to support for Maxim Semiconductor MAX77963.
	  This is a Power Management IC with RTC, Flash, Fuel Gauge, Haptic,
	  MUIC controls on chip.
	  This driver provides common support for accessing the device;
	  additional drivers

config MIDAS_MFD_WM8994
	bool "Support Wolfson Microelectronics WM8994"
	select MFD_CORE
	select REGMAP_I2C
	depends on I2C=y && GENERIC_HARDIRQS
	help
	  The WM8994 is a highly integrated hi-fi CODEC designed for
	  smartphone applicatiosn.  As well as audio functionality it
	  has on board GPIO and regulator functionality which is
	  supported via the relevant subsystems.  This driver provides
	  core support for the WM8994, in order to use the actual
	  functionaltiy of the device other drivers must be enabled.
```

## midas/spi/Kconfig
```kconfig
config SPI_S3C64XX
	tristate "Samsung S3C64XX series type SPI"
	depends on (ARCH_S3C64XX || ARCH_S5P64X0 || ARCH_EXYNOS4 || ARCH_EXYNOS5)
	select S3C64XX_DMA if ARCH_S3C64XX
	help
	  SPI driver for Samsung S3C64XX and newer SoCs.
```
