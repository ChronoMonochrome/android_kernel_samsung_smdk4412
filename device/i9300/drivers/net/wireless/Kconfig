## device/i9300/drivers/net/wireless/Kconfig
```kconfig
config BCM4334
	tristate "Bluetooth Lock driver"
	default m
	help
	  say M to compile it as module.

config WIFI_CONTROL_FUNC
	bool "Enable WiFi control function abstraction"
	help
	  Enables Power/Reset/Carddetect function abstraction

source "device/i9300/drivers/net/wireless/bcmdhd/Kconfig"
```

## device/i9300/drivers/nfc/Kconfig
```kconfig
config PN65N_NFC
    tristate "PN65N NFC driver"
	depends on I2C
	select CRC_CCITT
	default n
	---help---
	  Say yes if you want PN65N Near Field Communication driver.
	  This is for i2c connected version. If unsure, say N here.

	  To compile this driver as a module, choose m here. The module will
	  be called pn65n.
```

## device/i9300/drivers/power/Kconfig
```kconfig
config BATTERY_SAMSUNG
	tristate "Fake battery driver for samsung smdk boards"
	depends on PLAT_SAMSUNG_LEGACY
	help
	  Say Y to enable support for batteries with samsung chip.
```

## device/i9300/drivers/regulator/Kconfig
```kconfig
config REGULATOR_WM8994
	tristate "Wolfson Microelectronics WM8994 CODEC"
	depends on MFD_WM8994_LEGACY
	help
	  This driver provides support for the voltage regulators on the
	  WM8994 CODEC.

config REGULATOR_MAX77686
	tristate "Maxim 77686 regulator"
	depends on MFD_MAX77686_LEGACY
	help
	  This driver controls a Maxim 77686 regulator
	  via I2C bus. The provided regulator is suitable for
	  Exynos-4 chips to control VARM and VINT voltages.

config REGULATOR_MAX77693
	tristate "Maxim 777693 regulator"
	depends on MFD_MAX77693_LEGACY
	help
	  This driver control a Maxim 77693 regulator.
```

## device/i9300/drivers/rtc/Kconfig
```kconfig
config RTC_INTF_ALARM
	bool "Android alarm driver"
	depends on RTC_CLASS
	default y
	help
	  Provides non-wakeup and rtc backed wakeup alarms based on rtc or
	  elapsed realtime, and a non-wakeup alarm on the monotonic clock.
	  Also provides an interface to set the wall time which must be used
	  for elapsed realtime to work.

config RTC_INTF_ALARM_DEV
	bool "Android alarm device"
	depends on RTC_INTF_ALARM
	default y
	help
	  Exports the alarm interface to user-space.

config RTC_DRV_S3C_LEGACY
	tristate "Samsung S3C series SoC RTC"
	depends on ARCH_S3C64XX || HAVE_S3C_RTC
	help
	  RTC (Realtime Clock) driver for the clock inbuilt into the
	  Samsung S3C24XX series of SoCs. This can provide periodic
	  interrupt rates from 1Hz to 64Hz for user programs, and
	  wakeup from Alarm.

	  The driver currently supports the common features on all the
	  S3C24XX range, such as the S3C2410, S3C2412, S3C2413, S3C2440
	  and S3C2442.

	  This driver can also be build as a module. If so, the module
	  will be called rtc-s3c.

config RTC_DRV_MAX77686
	tristate "Maxim MAX77686"
	depends on MFD_MAX77686_LEGACY
	help
	  If you say yes here you will get support for the
	  RTC of Maxim MAX77686 PMIC.

	  This driver can also be built as a module. If so, the module
	  will be called rtc-max77686.
```

## device/i9300/drivers/staging/android/Kconfig
```kconfig
menu "Android"

config ANDROID_LEGACY
	bool "Android Drivers"
	default N
	---help---
	  Enable support for various drivers needed on the Android platform

if ANDROID_LEGACY

config ANDROID_BINDER_IPC_LEGACY
	bool "Android Binder IPC Driver"
	default n

config ANDROID_LOGGER_LEGACY
	tristate "Android log driver"
	default n

config ANDROID_RAM_CONSOLE_LEGACY
	bool "Android RAM buffer console"
	default n

config ANDROID_RAM_CONSOLE_LEGACY_ENABLE_VERBOSE
	bool "Enable verbose console messages on Android RAM console"
	default y
	depends on ANDROID_RAM_CONSOLE_LEGACY

menuconfig ANDROID_RAM_CONSOLE_LEGACY_ERROR_CORRECTION
	bool "Android RAM Console Enable error correction"
	default n
	depends on ANDROID_RAM_CONSOLE_LEGACY
	depends on !ANDROID_RAM_CONSOLE_LEGACY_EARLY_INIT
	select REED_SOLOMON
	select REED_SOLOMON_ENC8
	select REED_SOLOMON_DEC8

if ANDROID_RAM_CONSOLE_LEGACY_ERROR_CORRECTION

config ANDROID_RAM_CONSOLE_LEGACY_ERROR_CORRECTION_DATA_SIZE
	int "Android RAM Console Data data size"
	default 128
	help
	  Must be a power of 2.

config ANDROID_RAM_CONSOLE_LEGACY_ERROR_CORRECTION_ECC_SIZE
	int "Android RAM Console ECC size"
	default 16

config ANDROID_RAM_CONSOLE_LEGACY_ERROR_CORRECTION_SYMBOL_SIZE
	int "Android RAM Console Symbol size"
	default 8

config ANDROID_RAM_CONSOLE_LEGACY_ERROR_CORRECTION_POLYNOMIAL
	hex "Android RAM Console Polynomial"
	default 0x19 if (ANDROID_RAM_CONSOLE_LEGACY_ERROR_CORRECTION_SYMBOL_SIZE = 4)
	default 0x29 if (ANDROID_RAM_CONSOLE_LEGACY_ERROR_CORRECTION_SYMBOL_SIZE = 5)
	default 0x61 if (ANDROID_RAM_CONSOLE_LEGACY_ERROR_CORRECTION_SYMBOL_SIZE = 6)
	default 0x89 if (ANDROID_RAM_CONSOLE_LEGACY_ERROR_CORRECTION_SYMBOL_SIZE = 7)
	default 0x11d if (ANDROID_RAM_CONSOLE_LEGACY_ERROR_CORRECTION_SYMBOL_SIZE = 8)

endif # ANDROID_RAM_CONSOLE_LEGACY_ERROR_CORRECTION

config ANDROID_RAM_CONSOLE_LEGACY_EARLY_INIT
	bool "Start Android RAM console early"
	default n
	depends on ANDROID_RAM_CONSOLE_LEGACY

config ANDROID_RAM_CONSOLE_LEGACY_EARLY_ADDR
	hex "Android RAM console virtual address"
	default 0
	depends on ANDROID_RAM_CONSOLE_LEGACY_EARLY_INIT

config ANDROID_RAM_CONSOLE_LEGACY_EARLY_SIZE
	hex "Android RAM console buffer size"
	default 0
	depends on ANDROID_RAM_CONSOLE_LEGACY_EARLY_INIT

config ANDROID_TIMED_OUTPUT_LEGACY
	bool "Timed output class driver"
	default y

config ANDROID_TIMED_GPIO_LEGACY
	tristate "Android timed gpio driver"
	depends on GENERIC_GPIO && ANDROID_TIMED_OUTPUT_LEGACY
	default n

config ANDROID_LOW_MEMORY_KILLER_LEGACY
	bool "Android Low Memory Killer"
	default N
	---help---
	  Register processes to be killed when memory is low

config ANDROID_LMK_ADJ_RBTREE
	bool "Use RBTREE for Android Low Memory Killer"
	depends on ANDROID_LOW_MEMORY_KILLER
	default y
	---help---
	  Use oom_score_adj rbtree to select the best proecss to kill
	  when system in low memory status.

endif # if ANDROID_LEGACY

endmenu
```

## device/i9300/drivers/thermal/Kconfig
```kconfig
#
# Generic thermal sysfs drivers configuration
#

config CPU_THERMAL
	bool "generic cpu cooling support"
	depends on THERMAL
	help
	  This implements the generic cpu cooling mechanism through frequency
	  reduction, cpu hotplug and any other ways of reducing temperature. An
	  ACPI version of this already exists(drivers/acpi/processor_thermal.c).
	  This will be useful for platforms using the generic thermal interface
	  and not the ACPI interface.
	  If you want this support, you should say Y or M here.

config SAMSUNG_THERMAL_INTERFACE
	bool "Samsung Thermal interface support"
	depends on THERMAL && CPU_THERMAL
	help
	  This is a samsung thermal interface which will be used as
	  a link between sensors and cooling devices with linux thermal
	  framework.

config SENSORS_EXYNOS4_TMU
	tristate "Temperature sensor on Samsung EXYNOS4"
	depends on ARCH_EXYNOS4
	help
	  If you say yes here you get support for TMU (Thermal Managment
	  Unit) on SAMSUNG EXYNOS4 series of SoC.

	  This driver can also be built as a module. If so, the module
	  will be called exynos4-tmu.
```

## device/i9300/drivers/tty/serial/Kconfig
```kconfig
#
# The new 8250/16550 serial drivers
config SERIAL_8250
	tristate "8250/16550 and compatible serial support"
	select SERIAL_CORE
	---help---
	  This selects whether you want to include the driver for the standard
	  serial ports.  The standard answer is Y.  People who might say N
	  here are those that are setting up dedicated Ethernet WWW/FTP
	  servers, or users that have one of the various bus mice instead of a
	  serial mouse and don't intend to use their machine's standard serial
	  port for anything.  (Note that the Cyclades and Stallion multi
	  serial port drivers do not need this driver built in for them to
	  work.)

	  To compile this driver as a module, choose M here: the
	  module will be called 8250.
	  [WARNING: Do not compile this driver as a module if you are using
	  non-standard serial ports, since the configuration information will
	  be lost when the driver is unloaded.  This limitation may be lifted
	  in the future.]

	  BTW1: If you have a mouseman serial mouse which is not recognized by
	  the X window system, try running gpm first.

	  BTW2: If you intend to use a software modem (also called Winmodem)
	  under Linux, forget it.  These modems are crippled and require
	  proprietary drivers which are only available under Windows.

	  Most people will say Y or M here, so that they can use serial mice,
	  modems and similar devices connecting to the standard serial ports.

config SERIAL_8250_CONSOLE
	bool "Console on 8250/16550 and compatible serial port"
	depends on SERIAL_8250=y
	select SERIAL_CORE_CONSOLE
	---help---
	  If you say Y here, it will be possible to use a serial port as the
	  system console (the system console is the device which receives all
	  kernel messages and warnings and which allows logins in single user
	  mode). This could be useful if some terminal or printer is connected
	  to that serial port.

	  Even if you say Y here, the currently visible virtual console
	  (/dev/tty0) will still be used as the system console by default, but
	  you can alter that using a kernel command line option such as
	  "console=ttyS1". (Try "man bootparam" or see the documentation of
	  your boot loader (grub or lilo or loadlin) about how to pass options
	  to the kernel at boot time.)

	  If you don't have a VGA card installed and you say Y here, the
	  kernel will automatically use the first serial line, /dev/ttyS0, as
	  system console.

	  You can set that using a kernel command line option such as
	  "console=uart8250,io,0x3f8,9600n8"
	  "console=uart8250,mmio,0xff5e0000,115200n8".
	  and it will switch to normal serial console when the corresponding 
	  port is ready.
	  "earlycon=uart8250,io,0x3f8,9600n8"
	  "earlycon=uart8250,mmio,0xff5e0000,115200n8".
	  it will not only setup early console.

	  If unsure, say N.

config SERIAL_8250_NR_UARTS
	int "Maximum number of 8250/16550 serial ports"
	depends on SERIAL_8250
	default "4"
	help
	  Set this to the number of serial ports you want the driver
	  to support.  This includes any ports discovered via ACPI or
	  PCI enumeration and any ports that may be added at run-time
	  via hot-plug, or any ISA multi-port serial cards.

config SERIAL_8250_RUNTIME_UARTS
	int "Number of 8250/16550 serial ports to register at runtime"
	depends on SERIAL_8250
	range 0 SERIAL_8250_NR_UARTS
	default "4"
	help
	  Set this to the maximum number of serial ports you want
	  the kernel to register at boot time.  This can be overridden
	  with the module parameter "nr_uarts", or boot-time parameter
	  8250.nr_uarts

config SERIAL_SAMSUNG_LEGACY
	tristate "Samsung SoC serial support"
	depends on ARM && PLAT_SAMSUNG_LEGACY
	select SERIAL_CORE_LEGACY
	help
	  Support for the on-chip UARTs on the Samsung S3C24XX series CPUs,
	  providing /dev/ttySAC0, 1 and 2 (note, some machines may not
	  provide all of these ports, depending on how the serial port
	  pins are configured.

config SERIAL_SAMSUNG_UARTS_LEGACY_4
	bool
	depends on ARM && PLAT_SAMSUNG_LEGACY
	default y if !(CPU_S3C2410 || SERIAL_S3C2412 || CPU_S3C2440 || CPU_S3C2442)
	help
	  Internal node for the common case of 4 Samsung compatible UARTs

config SERIAL_SAMSUNG_UARTS_LEGACY
	int
	depends on ARM && PLAT_SAMSUNG_LEGACY
	default 6 if ARCH_S5P6450
	default 4 if SERIAL_SAMSUNG_UARTS_LEGACY_4 || CPU_S3C2416
	default 3
	help
	  Select the number of available UART ports for the Samsung S3C
	  serial driver
	
config SERIAL_SAMSUNG_LEGACY_DEBUG
	bool "Samsung SoC serial debug"
	depends on SERIAL_SAMSUNG_LEGACY && DEBUG_LL
	help
	  Add support for debugging the serial driver. Since this is
	  generally being used as a console, we use our own output
	  routines that go via the low-level debug printascii()
	  function.

config SERIAL_SAMSUNG_CONSOLE_LEGACY
	bool "Support for console on Samsung SoC serial port"
	depends on SERIAL_SAMSUNG_LEGACY=y
	select SERIAL_CORE_CONSOLE
	help
	  Allow selection of the S3C24XX on-board serial ports for use as
	  an virtual console.

	  Even if you say Y here, the currently visible virtual console
	  (/dev/tty0) will still be used as the system console by default, but
	  you can alter that using a kernel command line option such as
	  "console=ttySACx". (Try "man bootparam" or see the documentation of
	  your boot loader about how to pass options to the kernel at
	  boot time.)
```

## device/i9300/drivers/video/Kconfig
```kconfig
source "device/i9300/drivers/video/samsung/Kconfig"

config FB_MIPI_DSIM
       bool "Samsung MIPI DSIM"
       depends on FB_S3C
       default n
       ---help---
         This enables support for Samsung MIPI DSIM feature

config VIDEO_SAMSUNG_MEMSIZE_FIMD
       int "Memory size in kbytes for FIMD0"
       depends on FB_S3C
       default "102400"

config S5P_MIPI_DSI2
       tristate "Samsung SoC MIPI-DSI support."
       depends on !FB_S5P_MIPI_DSIM && (ARCH_S5PV210 || ARCH_EXYNOS4)
       default n
       ---help---
         This enables support for MIPI-DSI device.
```

## device/i9300/init/Kconfig
```kconfig
config ASHMEM
	bool "Enable the Anonymous Shared Memory Subsystem"
	default n
	depends on SHMEM || TINY_SHMEM
	help
	  The ashmem subsystem is a new shared memory allocator, similar to
	  POSIX SHM but with different behavior and sporting a simpler
	  file-based API.
```
